## components/board_display/Kconfig
```kconfig
menu "WROVER board display"
    config BOARD_DISPLAY_ENABLE
        bool "Enable confirmed ILI9341 board display"
        default n
    config BOARD_DISPLAY_DMA_PIPELINE
        bool "Overlap LCD strip rendering with one DMA transfer (experimental)"
        depends on BOARD_DISPLAY_ENABLE
        default n
        help
            Allocate a second internal DMA-capable strip buffer and render the
            next strip while the previous transfer is in flight. The SPI clock
            and transaction queue depth are unchanged. DMA resources are
            quarantined on uncertain completion. Normal operation has limited
            hardware coverage; fault paths and visual output remain unvalidated.
    config BOARD_WROVER_KIT_V41_CONFIRMED
        bool "PCB silkscreen and official v4.1 LCD wiring confirmed"
        depends on BOARD_DISPLAY_ENABLE
        default n
        help
            Required before any LCD GPIO is configured. This does not identify
            the panel controller. Two consistent ILI9341 ID reads are required;
            unknown or different IDs stop the display without trying other drivers.
endmenu
```

## components/lisp_repl/Kconfig
```kconfig
menu "LispBM REPL"
    config LISP_REPL_ENABLE
        bool "Enable RAM-only LispBM UART REPL and LCD terminal"
        depends on BOARD_DISPLAY_ENABLE && BOARD_WROVER_KIT_V41_CONFIRMED && SPIRAM
        default n
        help
            Experimental, opt-in. Uses UART0/115200 and the confirmed LCD.
            Lisp state and the upstream image are RAM-only. No NVS, filesystem,
            Bluetooth, DSP or arbitrary GPIO extensions. LCD lifecycle controls\n            do not mount SD cards. Ctrl-C resets the Lisp environment.
            Requires a separately installed pinned LispBM checkout (GPLv3+).
    config LISP_APP_ENABLE
        bool "Enable one foreground Lisp application with a full-screen canvas"
        depends on LISP_REPL_ENABLE
        default n
        help
            Opt-in, RAM-only callbacks and two fixed PSRAM RGB565 canvases
            (300 KiB). Original Lisp and LCD tasks retain sole ownership.
            UART Ctrl-C stops the app; TCP :stop and :key X remain available.
            No filesystem, persistent loader, GPIO, Bluetooth or DSP.
    config LISP_PERF_TRACE
        bool "Enable opt-in RAM app and LCD timing diagnostics"
        depends on LISP_APP_ENABLE
        default n
        help
            Diagnostic build only. Explicit :perf-start and :perf-stop bracket
            a session; bounded in-memory aggregates are printed once at stop.
            Samples are wall times and instrumentation changes scheduling.
            No per-frame output, persistent storage or automatic activation.
    config LISP_APP_URL_ENABLE
        bool "Enable HTTPS URL to RAM application loading"
        depends on LISP_APP_ENABLE && WIFI_SERVICE_CONNECT_ENABLE
        select ESP_HTTP_CLIENT_ENABLE_HTTPS
        select MBEDTLS_CERTIFICATE_BUNDLE
        select MBEDTLS_HAVE_TIME_DATE
        default n
        help
            Explicit app-load-url downloads up to 32 KiB ASCII source to RAM.
            CA/hostname/date validation; request-triggered SNTP if clock unset.
            No redirect, HTTP fallback, automatic app-run, Flash/NVS writes,
            persistent installation, dependency manager or boot-time requests.
    config WIFI_REPL_ENABLE
        bool "Enable plain TCP REPL on port2323 (no TLS/token)"
        depends on LISP_REPL_ENABLE && WIFI_SERVICE_CONNECT_ENABLE
        default n
        help
            No certificate, token or login. Anyone on the reachable LAN can
            execute RAM-only Lisp; use only on a trusted LAN, never public.
            Connect with nc DEVICE_IP 2323. One client, original Lisp owner and
            LCD output. OTA keeps its separate HTTPS certificate and token.
endmenu
```

## components/wifi_service/Kconfig
```kconfig
menu "Radio node Wi-Fi"
    config WIFI_SERVICE_ENABLE
        bool "Enable Wi-Fi diagnostic"
        default n
        help
            Passive scan unless station mode is explicitly enabled below.
            Neither mode starts SoftAP or HTTP.
            Requires ESP_WIFI_NVS_ENABLED=n,
            ESP_PHY_CALIBRATION_AND_DATA_STORAGE=n and
            ESP_PHY_INIT_DATA_IN_PARTITION=n. Compile guards enforce these.
            PHY performs full calibration on each boot instead of storing NVS.
    config WIFI_SERVICE_CONNECT_ENABLE
        bool "Enable station/DHCP instead of passive scanning"
        depends on WIFI_SERVICE_ENABLE
        default n
        help
            Embed a private local SSID/password file at build time using
            WIFI_CREDENTIALS_FILE; connect automatically on each boot.
            Credentials remain in application flash, but are not saved to NVS.
    config WIFI_SERVICE_US_CONFIRMED
        bool "Actual deployment location is confirmed United States"
        depends on WIFI_SERVICE_CONNECT_ENABLE
        default n
        help
            This station implementation uses US, channels 1-11, manual policy.
            Compile guard rejects station mode without explicit confirmation.
    config WIFI_SERVICE_SCAN_INTERVAL_SECONDS
        int "Delay between completed passive scans (seconds)"
        depends on WIFI_SERVICE_ENABLE
        range 15 600
        default 60
endmenu
```

## main/Kconfig.projbuild
```kconfig
menu "Firmware update strategy"
    config SINGLE_APP_USB_ENABLE
        bool "Single factory application; USB firmware updates and recovery"
        default y
        help
            Use partitions.single.csv: one factory app spanning the former
            A/B region. Wi-Fi TCP REPL remains independent. No network firmware
            update, HTTPS status server or bootloader application rollback.
            Preserve NVS and the old OTA control bytes as reserved data.
            Building is not permission to change a device partition table.
            Disable only for explicit historical dual-slot regression builds.
    config OTA_SERVICE_ENABLE
        bool "Legacy dual-slot regression: authenticated HTTPS application OTA"
        depends on WIFI_SERVICE_CONNECT_ENABLE && BOARD_DISPLAY_ENABLE && SPIRAM
        default n
        help
            Historical regression only; disable SINGLE_APP_USB_ENABLE.
            Requires separately approved dual-slot layout and rollback bootloader.
            Private token/TLS files are embedded via CMake, not sdkconfig.
            Never enables NVS or eFuses.
endmenu
```
